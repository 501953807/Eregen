## firmware/medical-wristband/community/esp32s3/Kconfig
```kconfig
menuconfig COMMUNITY_WB_OLED
    bool "Enable OLED display"
    default y
    help
        Enable SSD1306 OLED display for community wristband.

config COMMUNITY_WB_BLE_ADV_INTERVAL
    int "BLE advertising interval (ms)"
    range 20 10000
    default 1000
    depends on COMMUNITY_WB_BLE
    help
        Interval for BLE advertising in milliseconds.

endmenu
```

## firmware/medical-wristband/community/esp32s3/sdkconfig.defaults
```kconfig
# Eregen Community Wristband - ESP32-S3 SDK Config

## WiFi
CONFIG_ESP_WIFI_SSID="eregen-community"
CONFIG_ESP_WIFI_PASSWORD="eregen1234"

## MQTT (via wifi_mqtt_bridge)
CONFIG_MQTT_BROKER_URI="tcp://mqtt.eregen.local:1883"
CONFIG_MQTT_USERNAME="eregen"
CONFIG_MQTT_PASSWORD="eregen_password"

## BLE
CONFIG_BT_BLE_42_FEATURES_SUPPORTED=y
CONFIG_BT_BLE_ENABLED=y

## OLED (I2C GPIO)
CONFIG_OLED_SDA_GPIO=8
CONFIG_OLED_SCL_GPIO=9

## Logging
CONFIG_LOG_DEFAULT_LEVEL=INFO
CONFIG_LOG_MAXIMUM_LEVEL_INFO=y

## NVS
CONFIG_NVS_FLASH_PAGE_NUM=8
```

## firmware/medical-wristband/esp32s3/Kconfig
```kconfig
menuconfig "Eregen Medical Wristband Configuration"

menu "BLE Settings"
    config EREGEN_BLE_DEVICE_NAME
        string "BLE device name"
        default "Eregen-WB"
        help
            Name advertised over BLE during pairing and connection.

    config EREGEN_BLE_SECURITY_LEVEL
        int "BLE security level (1=none, 2=LE Security Mode 1, 3=LE Security Mode 2)"
        default 3
        help
            Security level for BLE GATT connections. Level 3 enables encrypted links.

    config EREGEN_BLE_PAIRING_CODE
        string "Default BLE pairing code"
        default ""
        help
            Hardcoded pairing code for development. Leave empty to use runtime-generated codes.
endmenu

menu "Firmware"
    config EREGEN_FIRMWARE_VERSION
        string "Firmware version string"
        default "0.1.0-dev"
        help
            Semantic version displayed during pairing and status queries.

    config EREGEN_FIRMWARE_BUILD_HASH
        string "Build hash"
        default "unknown"
        help
            Short git commit hash or build identifier.
endmenu

menu "OTA"
    config EREGEN_OTA_ENABLED
        bool "Enable OTA updates"
        default y
        help
            Allow firmware updates over BLE from nurse devices.

    config EREGEN_OTA_MAX_SIZE_KB
        int "Maximum OTA payload size in KB"
        default 256
        help
            Maximum chunk size for OTA firmware transfer.
endmenu
```

## firmware/medical-wristband/esp32s3/sdkconfig.defaults
```kconfig
# ESP-IDF v5.3 defaults for Eregen Medical Wristband (ESP32-S3)
CONFIG_ESP_SYSTEM_WIFI_POWEROFF_ENABLE=n
CONFIG_SPIRAM=n
CONFIG_ESP_CONSOLE_USB_SERIAL_JTAG=y
CONFIG_ESP_CONSOLE_UART_DEFAULT=n
CONFIG_ESP_CONSOLE_UART_CUSTOM=y
CONFIG_ESP_CONSOLE_UART_NUM=1
CONFIG_ESP_CONSOLE_UART_TX_GPIO=43
CONFIG_ESP_CONSOLE_UART_RX_GPIO=44
CONFIG_ESP_CONSOLE_UART_BAUDRATE=115200
CONFIG_IDF_TARGET="esp32s3"
CONFIG_ESP32S3_DEFAULT_CPU_FREQ_240=y
CONFIG_ESP32S3_FLASH_4MB=y
CONFIG_ESP32S3_FLASH_SPEED_80MHz=y
CONFIG_ESP32S3_RTC_CLK_SRC_INT_RC=y
CONFIG_BT_BLE_ENABLED=y
CONFIG_BT_BLE_ROLE_PERIPHERAL=y
CONFIG_BT_BLE_42_FEATURES_SUPPORTED=y
CONFIG_BT_BLE_ADV_DUP_MODE=y
CONFIG_FFS_FILE=y
CONFIG_FFS_CODECS=y
CONFIG_FFS_MEMORY_SIZE=0x10000
CONFIG_HEAP_MAIN_HEAP_SIZE=0x8000
CONFIG_FREERTOS_HZ=1000
CONFIG_LWIP_MAX_SOCKETS=4
```
